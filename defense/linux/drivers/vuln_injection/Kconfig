## defense/linux/drivers/vuln_injection/Kconfig
```kconfig
config VULN_INJECTION
	tristate "Vuln Injection For Testing"
	help
	  Turn on Vuln Injection For Testing.
	  Do not turn on this option in production kernel.
	default m

config TEST_IPI
	bool "Vuln Test For IPI"
	help
	  Do not turn on this option in production kernel.
	default y

config TEST_HRTIMER
	bool "Vuln Test For Hrtimer"
	help
	  Do not turn on this option in production kernel.
	default y
```

## defense/linux/mm/shadow_heap/Kconfig
```kconfig
config SHADOW_HEAP
    bool "Enable Shadow Heap"
    default n
    help
      Enable the Shadow Heap memory protection mechanism.
```

## dynamic_run/execute_env/linux-6.2.6/drivers/back_trace_alloc_print/Kconfig
```kconfig
config BACK_TRACE_ALLOC_PRINT 
    bool
    depends on BACK_TRACE_ALLOC
    default m
```
